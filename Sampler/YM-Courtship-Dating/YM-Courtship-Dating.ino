/*
 * Arduino YM2149 MIDI Synth
 * 
 * Based on re-factored Yukimizake code by Dansfing / dansfing.uk
 * Updated PCB design and modifications for 2024 by crunchypotato for HobbyChop.
 * This version has been modified to allow two simultaneous sample playbacks.
 *
 * This program is free software: you can redistribute it and/or modify
 * it under the terms of the GNU General Public License.
 */

//----------------- Fixed-Point Definitions -----------------
#define FP_SHIFT 8
#define FP_ONE   (1 << FP_SHIFT)

float defaultPitchMultiplier = .97 / 2;
#define PITCH_BEND_RANGE 12

//----------------- Prototypes for Note Functions (assumed defined elsewhere) -----------------
void playNote(byte note, byte velocity, byte channel, int detune);
void playNoteB(byte note, byte velocity, byte channel, int detune);
void stopNote(byte note, byte channel);
void stopNoteB(byte note, byte channel);

//----------------- Global Volume Controls -----------------
volatile uint8_t sample1VolumeScale = 1;  // Multiplier for channel 1
volatile uint8_t sample1MaxVolume   = 15;   // Maximum value for channel 1

//----------------- Helper Function to Scale a Sample -----------------
uint8_t applyVolumeScaling(uint8_t sample, uint8_t volumeOffset, uint8_t maxVolume) {
  uint8_t scaled = sample + volumeOffset;
  if (scaled > maxVolume) {
    scaled = maxVolume;
  }
  return scaled;
}

//----------------- Port Settings -----------------
const int ad0 = 8;
const int ad1 = 9;
const int ad2 = 2;
const int ad3 = 3;
const int ad4 = 4;
const int ad5 = 5;
const int ad6 = 6;
const int ad7 = 7;
const int pinBC1 = 10;   
const int pinBDIR = 11;
const int pinYMReset = 12;
#define buttonPin A1

const int actualPitch = 1;

// Global controls
bool setBankB;
byte defaultVolume = 0x0F;
byte defaultLevel = 10;
int mixerVolumeOffset = 5;
byte velo;
int velocityValue = 127;
int velocityStatus = 0;

// (Other CC controls omitted for brevity)

// NEW: Global low-pass filter coefficient, controlled by the mod wheel (CC1)
// A value from 16 (more filtering) to 255 (almost no filtering).
volatile uint8_t filterAlpha = 255;

// Fast pin switching functions
void setPinHigh(volatile uint8_t &port, uint8_t pin) {
  asm volatile("sbi %[port], %[pin]" 
               : 
               : [port] "I" (_SFR_IO_ADDR(port)), [pin] "I" (pin));
}

void setPinLow(volatile uint8_t &port, uint8_t pin) {
  asm volatile("cbi %[port], %[pin]" 
               : 
               : [port] "I" (_SFR_IO_ADDR(port)), [pin] "I" (pin));
}

#define __BCPORT__ PORTB
#define __BC1__ 2
#define __BDIR__ 3
#define __LEDPORT__ PORTB
#define __LED__ 5
#define CLEAR(port, pin) (port &= ~(1 << pin))

const int ledPin = 13;
unsigned long ledTurnOffTime = 0;
                
// Sample: 07 Courtship Dating-01
// Sample Rate: 4000 Hz, Sample Count: 794
PROGMEM const uint8_t s00[] = { 0, 0, 0, 15, 0, 0, 15, 15, 0, 0, 0, 15, 15,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 0, 0 };
const unsigned int s00_len = 794;

// Sample: 07 Courtship Dating-02
// Sample Rate: 4000 Hz, Sample Count: 741
PROGMEM const uint8_t s01[] = { 15, 0, 15, 0, 0, 15, 0, 15, 0, 0, 15, 0, 0,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 15, 15 };
const unsigned int s01_len = 741;

// Sample: 07 Courtship Dating-03
// Sample Rate: 4000 Hz, Sample Count: 979
PROGMEM const uint8_t s02[] = { 0, 0, 15, 0, 0, 0, 15, 15, 15, 0, 15, 15, 0,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 0, 15 };
const unsigned int s02_len = 979;

// Sample: 07 Courtship Dating-04
// Sample Rate: 4000 Hz, Sample Count: 794
PROGMEM const uint8_t s03[] = { 15, 15, 15, 15, 0, 0, 0, 0, 0, 0, 0, 0, 0,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 0, 0 };
const unsigned int s03_len = 794;

// Sample: 07 Courtship Dating-06
// Sample Rate: 4000 Hz, Sample Count: 952
PROGMEM const uint8_t s04[] = { 15, 0, 0, 0, 15, 15, 15, 15, 15, 0, 0, 0, 0,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 15, 15 };
const unsigned int s04_len = 952;

// Sample: 07 Courtship Dating-07
// Sample Rate: 4000 Hz, Sample Count: 1058
PROGMEM const uint8_t s05[] = { 0, 0, 15, 15, 0, 15, 15, 15, 15, 15, 0, 0, 0,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 0, 0 };
const unsigned int s05_len = 1058;

// Sample: 07 Courtship Dating-08
// Sample Rate: 4000 Hz, Sample Count: 1111
PROGMEM const uint8_t s06[] = { 0, 0, 0, 0, 15, 0, 15, 15, 0, 0, 0, 15, 15,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 0, 15 };
const unsigned int s06_len = 1111;

// Sample: 07 Courtship Dating-09
// Sample Rate: 4000 Hz, Sample Count: 1429
PROGMEM const uint8_t s07[] = { 15, 0, 15, 15, 15, 0, 0, 0, 0, 15, 15, 0, 15,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 0, 0 };
const unsigned int s07_len = 1429;

// Sample: 07 Courtship Dating-10
// Sample Rate: 4000 Hz, Sample Count: 952
PROGMEM const uint8_t s08[] = { 15, 0, 15, 0, 0, 0, 0, 0, 0, 15, 0, 0, 0,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 15, 0 };
const unsigned int s08_len = 952;

// Sample: 07 Courtship Dating-11
// Sample Rate: 4000 Hz, Sample Count: 847
PROGMEM const uint8_t s09[] = { 15, 15, 15, 15, 15, 15, 15, 15, 15, 15, 15, 15, 15,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 15, 0 };
const unsigned int s09_len = 847;

// Sample: 07 Courtship Dating-12
// Sample Rate: 4000 Hz, Sample Count: 1005
PROGMEM const uint8_t s10[] = { 0, 0, 0, 0, 0, 0, 0, 0, 0, 0, 0, 0, 15,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 0, 15 };
const unsigned int s10_len = 1005;

// Sample: 07 Courtship Dating-13
// Sample Rate: 4000 Hz, Sample Count: 952
PROGMEM const uint8_t s11[] = { 0, 15, 15, 15, 15, 15, 15, 15, 15, 15, 15, 15, 15,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 15, 0 };
const unsigned int s11_len = 952;

// Sample: 07 Courtship Dating-14
// Sample Rate: 4000 Hz, Sample Count: 635
PROGMEM const uint8_t s12[] = { 0, 0, 0, 0, 15, 15, 15, 15, 15, 15, 15, 15, 15,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 0, 0 };
const unsigned int s12_len = 635;

// Sample: 07 Courtship Dating-15
// Sample Rate: 4000 Hz, Sample Count: 635
PROGMEM const uint8_t s13[] = { 15, 15, 0, 0, 0, 0, 0, 15, 0, 0, 0, 0, 0,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 0, 15 };
const unsigned int s13_len = 635;

// Sample: 07 Courtship Dating-16
// Sample Rate: 4000 Hz, Sample Count: 847
PROGMEM const uint8_t s14[] = { 15, 15, 15, 0, 0, 0, 0, 0, 0, 0, 0, 0, 0,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 15, 0 };
const unsigned int s14_len = 847;

// Sample: 07 Courtship Dating-17
// Sample Rate: 4000 Hz, Sample Count: 1058
PROGMEM const uint8_t s15[] = { 15, 15, 0, 0, 0, 15, 0, 0, 0, 0, 0, 0, 0,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 15, 0 };
const unsigned int s15_len = 1058;

// Sample: 07 Courtship Dating-18
// Sample Rate: 4000 Hz, Sample Count: 635
PROGMEM const uint8_t s16[] = { 0, 15, 15, 15, 15, 15, 15, 15, 15, 15, 15, 0, 15,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 15, 0 };
const unsigned int s16_len = 635;

// Sample: 07 Courtship Dating-19
// Sample Rate: 4000 Hz, Sample Count: 847
PROGMEM const uint8_t s17[] = { 15, 15, 15, 15, 15, 0, 15, 15, 15, 0, 0, 0, 0,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 0, 0 };
const unsigned int s17_len = 847;

// Sample: 07 Courtship Dating-20
// Sample Rate: 4000 Hz, Sample Count: 211
PROGMEM const uint8_t s18[] = { 15, 0, 15, 15, 15, 0, 0, 0, 0, 0, 15, 15, 15,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 0, 0 };
const unsigned int s18_len = 211;

// Sample: 07 Courtship Dating-21
// Sample Rate: 4000 Hz, Sample Count: 238
PROGMEM const uint8_t s19[] = { 0, 0, 0, 15, 0, 15, 15, 0, 15, 15, 15, 15, 15,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 0, 0 };
const unsigned int s19_len = 238;

// Sample: 07 Courtship Dating-22
// Sample Rate: 4000 Hz, Sample Count: 555
PROGMEM const uint8_t s20[] = { 0, 0, 15, 15, 15, 15, 15, 15, 15, 0, 15, 15, 15,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 0, 15 };
const unsigned int s20_len = 555;

// Sample: 07 Courtship Dating-23
// Sample Rate: 4000 Hz, Sample Count: 211
PROGMEM const uint8_t s21[] = { 15, 0, 15, 0, 15, 0, 0, 0, 0, 15, 0, 0, 15,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 0, 15 };
const unsigned int s21_len = 211;

// Sample: 07 Courtship Dating-24
// Sample Rate: 4000 Hz, Sample Count: 900
PROGMEM const uint8_t s22[] = { 15, 15, 15, 15, 15, 15, 15, 15, 0, 0, 0, 0, 0,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 15, 15 };
const unsigned int s22_len = 900;

// Sample: 07 Courtship Dating-25
// Sample Rate: 4000 Hz, Sample Count: 397
PROGMEM const uint8_t s23[] = { 0, 15, 0, 0, 15, 15, 0, 0, 15, 15, 0, 15, 15,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 0, 15 };
const unsigned int s23_len = 397;


//----------------- Reverb Global Variables -----------------
#define REVERB_BUFFER_SIZE 256
#define REVERB_DELAY_SAMPLES 64   // Delay length in samples (adjust as desired)
volatile uint8_t reverbBuffer[REVERB_BUFFER_SIZE];
volatile uint16_t reverbWriteIndex = 0;
volatile uint8_t reverbMix = 0;      // 0 = no reverb, 100 = full reverb
volatile uint8_t reverbFeedback = 15;  // Adjust as desired

//----------------- Global Playback State -----------------
volatile const uint8_t *sample1Offset = 0;
volatile uint16_t sample1Length = 0;     // Effective (possibly shortened) sample length
volatile uint16_t sample1FullLength = 0;   // The full sample length (before shortening)
volatile uint32_t sample1Acc = 0;      // 24.8 fixed-point accumulator for channel 1
volatile uint32_t sample1Inc = FP_ONE / actualPitch;   // Phase increment for channel 1

// NEW: Global persistent CC3 value for sample shortening (0 = full length, 127 = shortest)
volatile byte cc3Value = 0;

// NEW: Global pitch bend factor, stored in fixed-point.
// Initialize with the default pitch multiplier.
volatile uint32_t globalPitchBendFactor = (uint32_t)(FP_ONE * defaultPitchMultiplier);

//----------------- Functions to Start Playback on Each Channel -----------------
void playDigidrum1(byte index, byte velo) {
  cli();
  digitalWrite(ledPin, HIGH);
  ledTurnOffTime = millis() + 500;
  
  switch (index) {
    case 48:
      sample1Offset = s00;
      sample1Length = s00_len;
      sample1FullLength = s00_len;
      break;
    case 49:
      sample1Offset = s01;
      sample1Length = s01_len;
      sample1FullLength = s01_len;
      break;
    case 50:
      sample1Offset = s02;
      sample1Length = s02_len;
      sample1FullLength = s02_len;
      break;
    case 51:
      sample1Offset = s03;
      sample1Length = s03_len;
      sample1FullLength = s03_len;
      break;
    case 52:
      sample1Offset = s04;
      sample1Length = s04_len;
      sample1FullLength = s04_len;
      break;
    case 53:
      sample1Offset = s05;
      sample1Length = s05_len;
      sample1FullLength = s05_len;
      break;
    case 54:
      sample1Offset = s06;
      sample1Length = s06_len;
      sample1FullLength = s06_len;
      break;
    case 55:
      sample1Offset = s07;
      sample1Length = s07_len;
      sample1FullLength = s07_len;
      break;
    case 56:
      sample1Offset = s08;
      sample1Length = s08_len;
      sample1FullLength = s08_len;
      break;
    case 57:
      sample1Offset = s09;
      sample1Length = s09_len;
      sample1FullLength = s09_len;
      break;
    case 58:
      sample1Offset = s10;
      sample1Length = s10_len;
      sample1FullLength = s10_len;
      break;
    case 59:
      sample1Offset = s11;
      sample1Length = s11_len;
      sample1FullLength = s11_len;
      break;
    case 60:
      sample1Offset = s12;
      sample1Length = s12_len;
      sample1FullLength = s12_len;
      break;
    case 61:
      sample1Offset = s13;
      sample1Length = s13_len;
      sample1FullLength = s13_len;
      break;
    case 62:
      sample1Offset = s14;
      sample1Length = s14_len;
      sample1FullLength = s14_len;
      break;
    case 63:
      sample1Offset = s15;
      sample1Length = s15_len;
      sample1FullLength = s15_len;
      break;
    case 64:
      sample1Offset = s16;
      sample1Length = s16_len;
      sample1FullLength = s16_len;
      break;
    case 65:
      sample1Offset = s17;
      sample1Length = s17_len;
      sample1FullLength = s17_len;
      break;
    case 66:
      sample1Offset = s18;
      sample1Length = s18_len;
      sample1FullLength = s18_len;
      break;
    case 67:
      sample1Offset = s19;
      sample1Length = s19_len;
      sample1FullLength = s19_len;
      break;
    case 68:
      sample1Offset = s20;
      sample1Length = s20_len;
      sample1FullLength = s20_len;
      break;
    case 69:
      sample1Offset = s21;
      sample1Length = s21_len;
      sample1FullLength = s21_len;
      break;
    case 70:
      sample1Offset = s22;
      sample1Length = s22_len;
      sample1FullLength = s22_len;
      break;
    case 71:
      sample1Offset = s23;
      sample1Length = s23_len;
      sample1FullLength = s23_len;
      break;
    default:
      sample1Offset = 0;
      sample1Length = 0;
      sample1FullLength = 0;
      break;
  }
  
  // Apply current CC3 shortening value to determine effective sample length.
  sample1Length = (sample1FullLength * (127 - cc3Value)) / 127;
  if (sample1Length < 1) sample1Length = 1;
  
  sample1VolumeScale = 1;
  sample1MaxVolume   = 15;
  sample1Acc = 0;
  // Set the phase increment using the global pitch bend factor
  sample1Inc = globalPitchBendFactor;
  sei();
}

//----------------- Timer2 ISR: Sample Playback with Reverb and Low-Pass Filtering -----------------
ISR(TIMER2_COMPA_vect) {
  uint16_t s1 = 0;
  // Channel 1 playback using fixed-point accumulator.
  if ((sample1Acc >> FP_SHIFT) < sample1Length) {
    s1 = pgm_read_byte_near(sample1Offset + (sample1Acc >> FP_SHIFT));
    s1 = applyVolumeScaling(s1, sample1VolumeScale, sample1MaxVolume);
    sample1Acc += sample1Inc;
  }
  
  uint8_t dry = (uint8_t)s1;
  
  // Reverb processing:
  uint16_t reverbReadIndex = (reverbWriteIndex + REVERB_BUFFER_SIZE - REVERB_DELAY_SAMPLES) % REVERB_BUFFER_SIZE;
  uint8_t delayedSample = reverbBuffer[reverbReadIndex];
  
  uint16_t outputSample = dry;
  if (reverbMix > 0) {
    outputSample = (dry * (100 - reverbMix) + delayedSample * reverbMix) / 100;
  }
  if (outputSample > 255) outputSample = 255;
  
  // One-pole low-pass filter: y[n] = y[n-1] + (alpha/256)*(x[n]-y[n-1])
  static uint8_t lpfOutput = 0;
  lpfOutput = lpfOutput + (((uint16_t)filterAlpha * ((uint16_t)outputSample - lpfOutput)) >> 8);
  
  send_data(0x0A, lpfOutput);
  
  // Update reverb buffer with feedback
  uint16_t newReverbSample = dry + (delayedSample * reverbFeedback) / 100;
  if (newReverbSample > 255) newReverbSample = 255;
  reverbBuffer[reverbWriteIndex] = (uint8_t)newReverbSample;
  
  reverbWriteIndex = (reverbWriteIndex + 1) % REVERB_BUFFER_SIZE;
}

//----------------- Standard Functions -----------------
bool setupOCR1A = false;

void setup() {
  // Initialize output pins
  pinMode(ad0, OUTPUT);
  pinMode(ad1, OUTPUT);
  pinMode(ad2, OUTPUT);
  pinMode(ad3, OUTPUT);
  pinMode(ad4, OUTPUT);
  pinMode(ad5, OUTPUT);
  pinMode(ad6, OUTPUT);
  pinMode(ad7, OUTPUT);
  pinMode(pinBC1, OUTPUT);
  pinMode(pinBDIR, OUTPUT);
  pinMode(pinYMReset, OUTPUT);
  pinMode(ledPin, OUTPUT);
  pinMode(buttonPin, INPUT);
  
  resetYM();
  Serial.begin(31250);
  
  // Clear reverb buffer
  for (uint16_t i = 0; i < REVERB_BUFFER_SIZE; i++) {
    reverbBuffer[i] = 0;
  }
  
  cli();
  // Timer2 setup for sample playback.
  TCCR2A = 0;
  TCCR2B = 0; 
  TCCR2A |= (1 << WGM21); 
  OCR2A = 499;  // Adjust for your desired base sample rate.
  TIMSK2 |= (1 << OCIE2A);
  TCCR2B |= (1 << CS21); 
  sei();

  // Trigger sample playback on channel 1 as an example.
  playDigidrum1(58, 127);
}

void loop() {
  byte command = getSerialByte();
  byte commandMSB = command & 0xF0;
  byte midiChannel = command & 0x0F;

  switch (commandMSB) {
    case 0x80: { // Note Off
      byte note = getSerialByte();
      if (setBankB)
        stopNoteB(note, midiChannel);
      else
        stopNote(note, midiChannel);
      break;
    }
    case 0x90: { // Note On
      byte note = getSerialByte();
      byte velo = getSerialByte();
      if (midiChannel == 0x00 && velo != 0) {
        playDigidrum1(note, velo);
      }
      break;
    }
    case 0xB0: { // Control Change
      handleControlChange(midiChannel);
      break;
    }
    case 0xA0:
    case 0xC0:
    case 0xD0:
      getSerialByte();
      getSerialByte();
      break;
    case 0xE0: { // Pitch Bend
      byte lsb = getSerialByte();
      byte msb = getSerialByte();
      uint16_t pitchValue = ((uint16_t)msb << 7) | lsb;
      handlePitchBend(pitchValue);
      break;
    }
  }
  if (millis() >= ledTurnOffTime) {
    digitalWrite(ledPin, LOW);
  }
}

void handlePitchBend(uint16_t pitchValue) {
  // MIDI pitch bend is 14-bit: 0 - 16383 with center at 8192.
  float bend = ((int)pitchValue - 8192) / 8192.0;
  float semitoneShift = bend * PITCH_BEND_RANGE;
  float factor = pow(2.0, semitoneShift / 12.0);
  // Multiply by the default pitch multiplier
  globalPitchBendFactor = (uint32_t)(FP_ONE * defaultPitchMultiplier * factor);
  sample1Inc = globalPitchBendFactor;
}

void handleControlChange(byte midiChannel) {
  byte controlNumber = getSerialByte();
  byte controlValue = getSerialByte();
  
  // Use mod wheel (CC1) to control low-pass filter:
  if (controlNumber == 1) {
    filterAlpha = 30 + ((controlValue * (255 - 30)) / 127);
  }
  // Use CC2 for reverb mix:
  else if (controlNumber == 2) {
    reverbMix = (controlValue * 100) / 127;  // Map 0-127 to 0-100%
  }
  // NEW: Use CC3 for sample shortening:
  else if (controlNumber == 3) {
    cc3Value = controlValue; // Save new CC3 value persistently
    if (sample1FullLength != 0) {
      uint16_t newLength = (sample1FullLength * (127 - cc3Value)) / 127;
      if (newLength < 1) newLength = 1;
      sample1Length = newLength;
    }
  }
  // (Other CC messages can be handled here.)
}

void resetYM() {
  digitalWrite(pinYMReset, LOW);
  digitalWrite(pinYMReset, HIGH);
  delay(1);
  send_data(0x07, 0b00111000);
  for (byte i = 0; i <= defaultLevel; i++) {
    send_data(0x08, i);
    send_data(0x09, i);
    send_data(0x0A, i);
    delay(1);
  }
}

void send_data(uint8_t address, uint8_t data) {
  outputToYM(address); // Send address first
  __BCPORT__ |= (1 << __BDIR__) | (1 << __BC1__);
  delayMicroseconds(10);
  __BCPORT__ &= ~((1 << __BDIR__) | (1 << __BC1__));
  outputToYM(data); // Send data
  __BCPORT__ |= (1 << __BDIR__);
  delayMicroseconds(10);
  __BCPORT__ &= ~(1 << __BDIR__);
  __LEDPORT__ &= ~(1 << __LED__);
}

void outputToYM(uint8_t value) {
  PORTB = (PORTB & 0xFC) | (value & 0x03); // Lower 2 bits to PB0-PB1
  PORTD = (value & 0xFC);                  // Upper 6 bits to PD2-PD7
}

void setPinState(volatile uint8_t &port, uint8_t pin, bool state) {
  if (state)
    setPinHigh(port, pin);
  else
    setPinLow(port, pin);
}

byte getSerialByte() {
  while (Serial.available() < 1)
    __asm__("nop\n\t");
  return Serial.read();
}

// Stub functions (to be defined if needed)
void playNote(byte note, byte velo, byte chan, int pitchBendValue){}
void stopNote(byte note, byte chan){}
void playNoteB(byte note, byte velo, byte chan, int pitchBendValue){}
void stopNoteB(byte note, byte chan){}
