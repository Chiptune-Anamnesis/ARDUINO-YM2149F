/*
 * Arduino YM2149 MIDI Synth v0.9 (Polyphonic Version)
 * 
 * Based on re-factored Yukimizake code by Dansfing / dansfing.uk
 * Updated PCB design and modifications for 2024 by crunchypotato for HobbyChop.
 * This version has been modified to allow two simultaneous sample playbacks.
 *
 * This program is free software: you can redistribute it and/or modify
 * it under the terms of the GNU General Public License.
 */

#include <avr/io.h>
#include <avr/interrupt.h>
#include <math.h>

//----------------- Fixed-Point Definitions -----------------
#define FP_SHIFT 8
#define FP_ONE   (1 << FP_SHIFT)

// For pitch bend: define range in semitones (±2 semitones in this example)
#define PITCH_BEND_RANGE 12

//----------------- Prototypes for note functions (assumed to be defined elsewhere) -----------------
void playNote(byte note, byte velocity, byte channel, int detune);
void playNoteB(byte note, byte velocity, byte channel, int detune);
void stopNote(byte note, byte channel);
void stopNoteB(byte note, byte channel);

//----------------- Global Volume Controls -----------------
volatile uint8_t sample1VolumeScale = 1;  // multiplier for channel 1
volatile uint8_t sample1MaxVolume   = 15;   // maximum value for channel 1

//----------------- Helper Function to Scale a Sample -----------------
uint8_t applyVolumeScaling(uint8_t sample, uint8_t volumeOffset, uint8_t maxVolume) {
  uint8_t scaled = sample + volumeOffset;
  if(scaled > maxVolume) {
    scaled = maxVolume;
  }
  return scaled;
}

//----------------- Port Settings -----------------
const int ad0 = 8;
const int ad1 = 9;
const int ad2 = 2;
const int ad3 = 3;
const int ad4 = 4;
const int ad5 = 5;
const int ad6 = 6;
const int ad7 = 7;
const int pinBC1 = 10;   
const int pinBDIR = 11;
const int pinYMReset = 12;
#define buttonPin A1

// Global controls
bool setBankB;
byte defaultVolume = 0x0F;
byte defaultLevel = 10;
int mixerVolumeOffset = 5;
byte velo;
int velocityValue = 127;
int velocityStatus = 0;
// (Other CC controls omitted for brevity)

// NEW: Global low-pass filter coefficient, controlled by the mod wheel (CC1)
// A value from 16 (more filtering) to 255 (almost no filtering).
volatile uint8_t filterAlpha = 150;

// Fast pin switching functions
void setPinHigh(volatile uint8_t &port, uint8_t pin) {
    asm volatile("sbi %[port], %[pin]" 
                 : 
                 : [port] "I" (_SFR_IO_ADDR(port)), [pin] "I" (pin));
}

void setPinLow(volatile uint8_t &port, uint8_t pin) {
    asm volatile("cbi %[port], %[pin]" 
                 : 
                 : [port] "I" (_SFR_IO_ADDR(port)), [pin] "I" (pin));
}

#define __BCPORT__ PORTB
#define __BC1__ 2
#define __BDIR__ 3
#define __LEDPORT__ PORTB
#define __LED__ 5
#define CLEAR(port, pin) (port &= ~(1 << pin))

const int ledPin = 13;
unsigned long ledTurnOffTime = 0;
                
// Sample: DPCMclap2_C4
// Sample Rate: 4000 Hz, Sample Count: 777
PROGMEM const uint8_t DPCMclap2_C4[] = { 7, 8, 8, 8, 8, 8, 8, 8, 8, 9, 8, 8, 8,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 7, 7 };
const unsigned int DPCMclap2_C4_len = 777;

// Sample: DPCMclap_C4
// Sample Rate: 4000 Hz, Sample Count: 1011
PROGMEM const uint8_t DPCMclap_C4[] = { 8, 8, 8, 7, 8, 7, 8, 7, 11, 9, 8, 10, 15,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 8, 7 };
const unsigned int DPCMclap_C4_len = 1011;

// Sample: DPCMdog_C4
// Sample Rate: 4000 Hz, Sample Count: 1066
PROGMEM const uint8_t DPCMdog_C4[] = { 8, 8, 9, 9, 8, 8, 8, 9, 8, 8, 8, 9, 9,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 8, 7 };
const unsigned int DPCMdog_C4_len = 1066;

// Sample: DPCMfiltersnap_C4
// Sample Rate: 4000 Hz, Sample Count: 238
PROGMEM const uint8_t DPCMfiltersnap_C4[] = { 8, 8, 8, 8, 8, 8, 9, 8, 8, 10, 12, 10, 9,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 8, 7 };
const unsigned int DPCMfiltersnap_C4_len = 238;

// Sample: DPCMkick1_C4
// Sample Rate: 4000 Hz, Sample Count: 406
PROGMEM const uint8_t DPCMkick1_C4[] = { 7, 8, 7, 8, 7, 9, 11, 11, 8, 10, 10, 9, 14,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 7, 7 };
const unsigned int DPCMkick1_C4_len = 406;

// Sample: DPCMkick2_C4
// Sample Rate: 4000 Hz, Sample Count: 406
PROGMEM const uint8_t DPCMkick2_C4[] = { 7, 8, 7, 8, 8, 8, 8, 8, 8, 8, 8, 8, 7,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 7, 7 };
const unsigned int DPCMkick2_C4_len = 406;

// Sample: DPCMkickhard_C4
// Sample Rate: 4000 Hz, Sample Count: 1055
PROGMEM const uint8_t DPCMkickhard_C4[] = { 8, 7, 8, 7, 8, 8, 10, 11, 14, 13, 12, 9, 10,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 7, 7 };
const unsigned int DPCMkickhard_C4_len = 1055;

// Sample: DPCMlaser_C4
// Sample Rate: 4000 Hz, Sample Count: 1132
PROGMEM const uint8_t DPCMlaser_C4[] = { 8, 8, 8, 8, 8, 8, 8, 10, 8, 7, 8, 11, 14,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 7, 7 };
const unsigned int DPCMlaser_C4_len = 1132;

// Sample: DPCMscream_C4
// Sample Rate: 4000 Hz, Sample Count: 2048
PROGMEM const uint8_t DPCMscream_C4[] = { 7, 8, 7, 8, 7, 8, 7, 8, 7, 8, 7, 8, 7,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 11, 5 };
const unsigned int DPCMscream_C4_len = 2048;

// Sample: DPCMsnare9092_C4
// Sample Rate: 4000 Hz, Sample Count: 468
PROGMEM const uint8_t DPCMsnare9092_C4[] = { 6, 4, 4, 4, 4, 4, 4, 3, 4, 8, 15, 8, 0,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 7, 8 };
const unsigned int DPCMsnare9092_C4_len = 468;

// Sample: DPCMsnare909_C4
// Sample Rate: 4000 Hz, Sample Count: 453
PROGMEM const uint8_t DPCMsnare909_C4[] = { 6, 4, 4, 4, 4, 3, 4, 8, 15, 15, 15, 15, 7,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 7, 8 };
const unsigned int DPCMsnare909_C4_len = 453;

// Sample: DPCMsnarecontra_C4
// Sample Rate: 4000 Hz, Sample Count: 666
PROGMEM const uint8_t DPCMsnarecontra_C4[] = { 11, 15, 15, 15, 15, 15, 15, 15, 15, 13, 12, 10, 6,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 7, 6 };
const unsigned int DPCMsnarecontra_C4_len = 666;

// Sample: DPCMsnarehigh_C4
// Sample Rate: 4000 Hz, Sample Count: 875
PROGMEM const uint8_t DPCMsnarehigh_C4[] = { 7, 6, 6, 6, 6, 5, 5, 5, 5, 5, 5, 5, 4,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 7, 8 };
const unsigned int DPCMsnarehigh_C4_len = 875;

// Sample: DPCMstick_C4
// Sample Rate: 4000 Hz, Sample Count: 249
PROGMEM const uint8_t DPCMstick_C4[] = { 9, 9, 9, 9, 9, 9, 9, 9, 9, 9, 9, 9, 9,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 8, 8 };
const unsigned int DPCMstick_C4_len = 249;

// Sample: DPCMsynthdrum_C4
// Sample Rate: 4000 Hz, Sample Count: 2048
PROGMEM const uint8_t DPCMsynthdrum_C4[] = { 7, 6, 6, 6, 6, 6, 6, 9, 11, 13, 12, 11, 7,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 8, 7 };
const unsigned int DPCMsynthdrum_C4_len = 2048;

// Sample: DPCMtaiko_C4
// Sample Rate: 4000 Hz, Sample Count: 2048
PROGMEM const uint8_t DPCMtaiko_C4[] = { 6, 4, 5, 4, 4, 4, 4, 4, 4, 4, 3, 4, 4,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 8, 8 };
const unsigned int DPCMtaiko_C4_len = 2048;

// Sample: DPCMtick_C4
// Sample Rate: 4000 Hz, Sample Count: 353
PROGMEM const uint8_t DPCMtick_C4[] = { 7, 7, 7, 8, 8, 8, 8, 8, 8, 8, 8, 8, 8,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 7, 7 };
const unsigned int DPCMtick_C4_len = 353;

// Sample: DPCMtimbA1_A_1
// Sample Rate: 4000 Hz, Sample Count: 2048
PROGMEM const uint8_t DPCMtimbA1_A_1[] = { 7, 8, 7, 7, 8, 7, 8, 7, 8, 7, 8, 7, 8,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 7, 7 };
const unsigned int DPCMtimbA1_A_1_len = 2048;

// Sample: DPCMtimbA1_A1
// Sample Rate: 4000 Hz, Sample Count: 2048
PROGMEM const uint8_t DPCMtimbA1_A1[] = { 7, 8, 7, 7, 8, 7, 8, 7, 8, 7, 8, 7, 8,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 7, 7 };
const unsigned int DPCMtimbA1_A1_len = 2048;

// Sample: NOISEhihat909_C4
// Sample Rate: 4000 Hz, Sample Count: 406
PROGMEM const uint8_t NOISEhihat909_C4[] = { 8, 8, 7, 8, 7, 8, 7, 9, 10, 10, 10, 8, 8,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 8, 8 };
const unsigned int NOISEhihat909_C4_len = 406;

// Sample: NOISEhihatclosed_C4
// Sample Rate: 4000 Hz, Sample Count: 136
PROGMEM const uint8_t NOISEhihatclosed_C4[] = { 6, 8, 7, 8, 11, 15, 8, 10, 9, 11, 10, 11, 12,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 5, 6 };
const unsigned int NOISEhihatclosed_C4_len = 136;

// Sample: NOISEhihatopen_C4
// Sample Rate: 4000 Hz, Sample Count: 1220
PROGMEM const uint8_t NOISEhihatopen_C4[] = { 8, 7, 7, 7, 8, 7, 7, 7, 7, 7, 9, 12, 12,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 7, 7 };
const unsigned int NOISEhihatopen_C4_len = 1220;

// Sample: NOISEhihatvibra_C4
// Sample Rate: 4000 Hz, Sample Count: 1171
PROGMEM const uint8_t NOISEhihatvibra_C4[] = { 8, 8, 7, 9, 7, 10, 7, 10, 7, 12, 7, 10, 7,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 7, 7 };
const unsigned int NOISEhihatvibra_C4_len = 1171;

// Sample: NOISEtiny1_C4
// Sample Rate: 4000 Hz, Sample Count: 308
PROGMEM const uint8_t NOISEtiny1_C4[] = { 8, 7, 8, 7, 10, 15, 15, 15, 15, 9, 6, 7, 7,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 8, 7 };
const unsigned int NOISEtiny1_C4_len = 308;

// Sample: NOISEtiny2_C4
// Sample Rate: 4000 Hz, Sample Count: 310
PROGMEM const uint8_t NOISEtiny2_C4[] = { 8, 7, 8, 7, 10, 15, 15, 8, 7, 7, 7, 7, 6,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 7, 7 };
const unsigned int NOISEtiny2_C4_len = 310;

// Sample: NOISEtiny3_C4
// Sample Rate: 4000 Hz, Sample Count: 289
PROGMEM const uint8_t NOISEtiny3_C4[] = { 7, 8, 7, 7, 9, 15, 10, 7, 7, 7, 7, 12, 15,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 7, 8 };
const unsigned int NOISEtiny3_C4_len = 289;

//----------------- Reverb Global Variables -----------------
// Define a small circular buffer for the delay
#define REVERB_BUFFER_SIZE 256
#define REVERB_DELAY_SAMPLES 64   // Delay length in samples (adjust as desired)
volatile uint8_t reverbBuffer[REVERB_BUFFER_SIZE];
volatile uint16_t reverbWriteIndex = 0;
// The reverb mix (0-100%) will be controlled by the mod wheel (CC2 in this example)
volatile uint8_t reverbMix = 0;      // 0 = no reverb, 100 = full reverb
// A fixed feedback percentage to feed some of the wet signal back into the delay
volatile uint8_t reverbFeedback = 15;  // Adjust as desired

//----------------- Global Playback State -----------------
// Instead of using a simple 16-bit counter, we use a fixed-point accumulator.
volatile const uint8_t *sample1Offset = 0;
volatile uint16_t sample1Length = 0;
volatile uint32_t sample1Acc = 0;      // 24.8 fixed-point accumulator for channel 1
volatile uint32_t sample1Inc = FP_ONE;   // Phase increment for channel 1

volatile const uint8_t *sample2Offset = 0;
volatile uint16_t sample2Length = 0;
volatile uint32_t sample2Acc = 0;      // 24.8 fixed-point accumulator for channel 2
volatile uint32_t sample2Inc = FP_ONE;   // Phase increment for channel 2

// NEW: Global pitch bend factor, stored in fixed-point.
volatile uint32_t globalPitchBendFactor = FP_ONE / 1;

//----------------- Functions to Start Playback on Each Channel -----------------
void playDigidrum1(byte index, byte velo) {
  cli();
  digitalWrite(ledPin, HIGH);
  ledTurnOffTime = millis() + 500;
  switch (index) {
      sample1Acc = 0;
  // UPDATED: Instead of resetting to FP_ONE, use the current global pitch bend factor.
  sample1Inc = globalPitchBendFactor;
  sei();
    case 48:
      sample1Offset = NOISEhihatvibra_C4;
      sample1Length = NOISEhihatvibra_C4_len;
      sample1VolumeScale = 3;
      sample1MaxVolume   = 15;
      break;
    case 49:
      sample1Offset = NOISEhihatopen_C4;
      sample1Length = NOISEhihatopen_C4_len;
      sample1VolumeScale = 3;
      sample1MaxVolume   = 15;
      break;
    case 50:
      sample1Offset = NOISEhihatclosed_C4;
      sample1Length = NOISEhihatclosed_C4_len;
      sample1VolumeScale = 3;
      sample1MaxVolume   = 15;
      break;
    case 51:
      sample1Offset = NOISEhihat909_C4;
      sample1Length = NOISEhihat909_C4_len;
      sample1VolumeScale = 3;
      sample1MaxVolume   = 15;
      break;
    case 52:
      sample1Offset = DPCMsynthdrum_C4;
      sample1Length = DPCMsynthdrum_C4_len;
      sample1VolumeScale = 1;
      sample1MaxVolume   = 15;
      break;
    case 53:
      sample1Offset = DPCMstick_C4;
      sample1Length = DPCMstick_C4_len;
      sample1VolumeScale = 1;
      sample1MaxVolume   = 15;
      break;
    case 54:
      sample1Offset = DPCMsnarehigh_C4;
      sample1Length = DPCMsnarehigh_C4_len;
      sample1VolumeScale = 1;
      sample1MaxVolume   = 15;
      break;
    case 55:
      sample1Offset = DPCMsnarecontra_C4;
      sample1Length = DPCMsnarecontra_C4_len;
      sample1VolumeScale = 1;
      sample1MaxVolume   = 15;
      break;
    case 56:
      sample1Offset = DPCMsnare909_C4;
      sample1Length = DPCMsnare909_C4_len;
      sample1VolumeScale = 1;
      sample1MaxVolume   = 15;
      break;
    case 57:
      sample1Offset = DPCMsnare9092_C4;
      sample1Length = DPCMsnare9092_C4_len;
      sample1VolumeScale = 1;
      sample1MaxVolume   = 15;
      break;
    case 58:
      sample1Offset = DPCMscream_C4;
      sample1Length = DPCMscream_C4_len;
      sample1VolumeScale = 3;
      sample1MaxVolume   = 15;
      break;
    case 59:
      sample1Offset = DPCMlaser_C4;
      sample1Length = DPCMlaser_C4_len;
      sample1VolumeScale = 1;
      sample1MaxVolume   = 15;
      break;
    case 60:
      sample1Offset = DPCMkickhard_C4;
      sample1Length = DPCMkickhard_C4_len;
      sample1VolumeScale = 1;
      sample1MaxVolume   = 15;
      break;
    case 61:
      sample1Offset = DPCMkick2_C4;
      sample1Length = DPCMkick2_C4_len;
      sample1VolumeScale = 1;
      sample1MaxVolume   = 15;
      break;
    case 62:
      sample1Offset = DPCMkick1_C4;
      sample1Length = DPCMkick1_C4_len;
      sample1VolumeScale = 1;
      sample1MaxVolume   = 15;
      break;
    case 63:
      sample1Offset = DPCMclap_C4;
      sample1Length = DPCMclap_C4_len;
      sample1VolumeScale = 1;
      sample1MaxVolume   = 15;
      break;
    case 64:
      sample1Offset = DPCMclap2_C4;
      sample1Length = DPCMclap2_C4_len;
      sample1VolumeScale = 1;
      sample1MaxVolume   = 15;
      break;
    case 65:
      sample1Offset = DPCMtick_C4;
      sample1Length = DPCMtick_C4_len;
      sample1VolumeScale = 1;
      sample1MaxVolume   = 15;
      break;
    case 66:
      sample1Offset = DPCMtimbA1_A_1;
      sample1Length = DPCMtimbA1_A_1_len;
      sample1VolumeScale = 1;
      sample1MaxVolume   = 15;
      break;
    case 67:
      sample1Offset = DPCMtimbA1_A1;
      sample1Length = DPCMtimbA1_A1_len;
      sample1VolumeScale = 1;
      sample1MaxVolume   = 15;
      break;
    case 68:
      sample1Offset = NOISEtiny1_C4;
      sample1Length = NOISEtiny1_C4_len;
      sample1VolumeScale = 1;
      sample1MaxVolume   = 15;
      break;
    case 69:
      sample1Offset = NOISEtiny2_C4;
      sample1Length = NOISEtiny2_C4_len;
      sample1VolumeScale = 1;
      sample1MaxVolume   = 15;
      break;
    case 70:
      sample1Offset = NOISEtiny3_C4;
      sample1Length = NOISEtiny3_C4_len;
      sample1VolumeScale = 1;
      sample1MaxVolume   = 15;
      break;
    case 71:
      sample1Offset = DPCMdog_C4;
      sample1Length = DPCMdog_C4_len;
      sample1VolumeScale = 1;
      sample1MaxVolume   = 15;
      break;
    case 72:
      sample1Offset = DPCMfiltersnap_C4;
      sample1Length = DPCMfiltersnap_C4_len;
      sample1VolumeScale = 1;
      sample1MaxVolume   = 15;
      break;
    default:
      sample1Offset = 0;
      sample1Length = 0;
      break;
  }
  sample1Acc = 0;
  // UPDATED: Instead of resetting to FP_ONE, use the current global pitch bend factor.
  sample1Inc = globalPitchBendFactor;
  sei();
}


//----------------- Timer2 ISR: Sample Playback with Reverb and Low Pass Filtering -----------------
ISR(TIMER2_COMPA_vect) {
  uint16_t s1 = 0;
  // Channel 1: Use the accumulator for fractional stepping.
  if ((sample1Acc >> FP_SHIFT) < sample1Length) {
    s1 = pgm_read_byte_near(sample1Offset + (sample1Acc >> FP_SHIFT));
    s1 = applyVolumeScaling(s1, sample1VolumeScale, sample1MaxVolume);
    sample1Acc += sample1Inc;
  }
  
  // Dry sample from channel 1:
  uint8_t dry = (uint8_t)s1;
  
  // --- Reverb Processing ---
  // Calculate the read index for the delayed sample:
  uint16_t reverbReadIndex = (reverbWriteIndex + REVERB_BUFFER_SIZE - REVERB_DELAY_SAMPLES) % REVERB_BUFFER_SIZE;
  uint8_t delayedSample = reverbBuffer[reverbReadIndex];
  
  // Mix dry and wet according to the reverb mix percentage.
  // When reverbMix is 0, only the dry signal is heard.
  uint16_t outputSample = dry;
  if (reverbMix > 0) {
    outputSample = (dry * (100 - reverbMix) + delayedSample * reverbMix) / 100;
  }
  if (outputSample > 255) outputSample = 255;
  
  // --- Low-Pass Filter Processing (NEW) ---
  // A one-pole low-pass filter: y[n] = y[n-1] + (alpha/256)*(x[n]-y[n-1])
  // We use a static variable to keep the previous filter state.
  static uint8_t lpfOutput = 0;
  lpfOutput = lpfOutput + (((uint16_t)filterAlpha * ((uint16_t)outputSample - lpfOutput)) >> 8);
  
  // Output the filtered sample:
  send_data(0x0A, lpfOutput);
  
  // --- Update the Reverb Buffer ---
  uint16_t newReverbSample = dry + (delayedSample * reverbFeedback) / 100;
  if (newReverbSample > 255) newReverbSample = 255;
  reverbBuffer[reverbWriteIndex] = (uint8_t)newReverbSample;
  
  // Increment and wrap the reverb buffer index:
  reverbWriteIndex = (reverbWriteIndex + 1) % REVERB_BUFFER_SIZE;
}


//----------------- Standard Functions -----------------
bool setupOCR1A = false;

void setup() {
  // Initialize output pins
  pinMode(ad0, OUTPUT);
  pinMode(ad1, OUTPUT);
  pinMode(ad2, OUTPUT);
  pinMode(ad3, OUTPUT);
  pinMode(ad4, OUTPUT);
  pinMode(ad5, OUTPUT);
  pinMode(ad6, OUTPUT);
  pinMode(ad7, OUTPUT);
  pinMode(pinBC1, OUTPUT);
  pinMode(pinBDIR, OUTPUT);
  pinMode(pinYMReset, OUTPUT);
  pinMode(ledPin, OUTPUT);
  pinMode(buttonPin, INPUT);
  
  resetYM();
  Serial.begin(31250);
  
  // Initialize the reverb buffer to zero.
  for (uint16_t i = 0; i < REVERB_BUFFER_SIZE; i++) {
    reverbBuffer[i] = 0;
  }
  
  cli();
  // Timer2 setup for sample playback.
  // Using a fixed rate for the ISR; the sample playback rate is controlled by our phase increment.
  TCCR2A = 0;
  TCCR2B = 0; 
  TCCR2A |= (1 << WGM21); 
  OCR2A = 249;  // Adjust as needed for your desired base sample rate.
  TIMSK2 |= (1 << OCIE2A);
  TCCR2B |= (1 << CS21); 
  sei();

  // Trigger sample playback on channel 1 as an example.
  playDigidrum1(58, 127);
  // Optionally, trigger channel 2 as well:
  // playDigidrum2(58, 127);
}

void loop() {
  byte command = getSerialByte();
  byte commandMSB = command & 0xF0;
  byte midiChannel = command & 0x0F;

  switch (commandMSB) {
    case 0x80: { // Note Off
      byte note = getSerialByte();
      if (setBankB)
        stopNoteB(note, midiChannel);
      else
        stopNote(note, midiChannel);
      break;
    }
    
    case 0x90: { // Note On
      byte note = getSerialByte();
      byte velo = getSerialByte();
      if (midiChannel == 0x00 && velo != 0) {
        // For this example, we trigger channel 1.
        playDigidrum1(note, velo);
      }
      break;
    }
    
    // Handle Control Change messages (0xB0)
    case 0xB0: {
      handleControlChange(midiChannel);
      break;
    }
    
    // For Key Pressure, Program Change, Channel Pressure:
    case 0xA0:
    case 0xC0:
    case 0xD0:
      getSerialByte();
      getSerialByte();
      break;

    case 0xE0: { // Pitch Bend
      // Pitch bend messages have 2 data bytes (LSB then MSB)
      byte lsb = getSerialByte();
      byte msb = getSerialByte();
      uint16_t pitchValue = ((uint16_t)msb << 7) | lsb;
      handlePitchBend(pitchValue);
      break;
    }
  }
  if (millis() >= ledTurnOffTime) {
    digitalWrite(ledPin, LOW);
  }
}

void handlePitchBend(uint16_t pitchValue) {
  // MIDI pitch bend is 14 bits: 0 - 16383, center at 8192.
  float bend = ((int)pitchValue - 8192) / 8192.0;
  
  // Remove the -12 semitones offset for a centered pitch.
  float semitoneShift = bend * PITCH_BEND_RANGE;
  
  // Calculate the playback factor using equal temperament.
  float factor = pow(2.0, semitoneShift / 12.0);
  
  // Update the global pitch bend factor:
  globalPitchBendFactor = (uint32_t)(FP_ONE * factor);
  
  // Apply the new factor to both channels immediately.
  sample1Inc = globalPitchBendFactor;
  sample2Inc = globalPitchBendFactor;
}


void handleControlChange(byte midiChannel) {
  byte controlNumber = getSerialByte();
  byte controlValue = getSerialByte();
  
  // NEW: Use mod wheel (CC1) for low-pass filter control:
  if (controlNumber == 1) {
    // Map 0-127 to filterAlpha values from 16 (more filtering) to 255 (nearly bypassed).
    filterAlpha = 30 + ((controlValue * (255 - 30)) / 127);
  }
  // Use CC2 for reverb mix:
  else if (controlNumber == 2) {
    reverbMix = (controlValue * 100) / 127;  // Map 0-127 to 0-100%
  }
  // (Other CC messages can be handled here as needed.)
}

void resetYM() {
  digitalWrite(pinYMReset, LOW);
  digitalWrite(pinYMReset, HIGH);
  delay(1);
  send_data(0x07, 0b00111000);
  for (byte i = 0; i <= defaultLevel; i++) {
    send_data(0x08, i);
    send_data(0x09, i);
    send_data(0x0A, i);
    delay(1);
  }
}

void send_data(uint8_t address, uint8_t data) {
  outputToYM(address); // Send address first
  __BCPORT__ |= (1 << __BDIR__) | (1 << __BC1__);
  delayMicroseconds(10);
  __BCPORT__ &= ~((1 << __BDIR__) | (1 << __BC1__));
  outputToYM(data); // Send data
  __BCPORT__ |= (1 << __BDIR__);
  delayMicroseconds(10);
  __BCPORT__ &= ~(1 << __BDIR__);
  __LEDPORT__ &= ~(1 << __LED__);
}

void outputToYM(uint8_t value) {
  PORTB = (PORTB & 0xFC) | (value & 0x03); // Lower 2 bits to PB0-PB1
  PORTD = (value & 0xFC);                  // Upper 6 bits to PD2-PD7
}

void setPinState(volatile uint8_t &port, uint8_t pin, bool state) {
  if (state)
    setPinHigh(port, pin);
  else
    setPinLow(port, pin);
}

byte getSerialByte() {
  while (Serial.available() < 1)
    __asm__("nop\n\t");
  return Serial.read();
}

void playNote(byte note, byte velo, byte chan, int pitchBendValue){}
void stopNote(byte note, byte chan){}
void playNoteB(byte note, byte velo, byte chan, int pitchBendValue){}
void stopNoteB(byte note, byte chan){}
