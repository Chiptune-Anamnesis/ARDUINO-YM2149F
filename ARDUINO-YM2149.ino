/*
 * Arduino YM2149 MIDI Synth v0.5
 * 
 * Original code developed by yukimizake.
 * Video demonstration: Soon.
 * Schematics: Soon.
 * Based on re-factored code by Dansfing / dansfing.uk (https://dansfing.uk/YM_v2_1b/YM_MIDI_lib_Screen_buttons/YM_MIDI_lib_Screen_buttons.ino)
 * Updated PCB design and modifications for 2024 by crunchypotato for HobbyChop.
 * OLED display not initially supported in this version but the pins are available on the PCB headers.
 * Replaced 2 samples for Channel 10 with smaller samples.
 * Added comments to playNote code.
 * Remapped velocity 1-127 to 64-127 and implemented velocity examples in MIDI CH. 1 and 4. 
 * Future progress will be in commit messages.
 *
 * This program is free software: you can redistribute it and/or modify
 * it under the terms of the GNU General Public License as published by
 * the Free Software Foundation, either version 3 of the License, or
 * (at your option) any later version.
 *
 * This program is distributed in the hope that it will be useful,
 * but WITHOUT ANY WARRANTY; without even the implied warranty of
 * MERCHANTABILITY or FITNESS FOR A PARTICULAR PURPOSE. See the
 * GNU General Public License for more details.
 *
 * You should have received a copy of the GNU General Public License
 * along with this program. If not, see <http://www.gnu.org/licenses/>.
 */

#include <avr/io.h>
#include <avr/interrupt.h>
#include <Arduino.h>

void playNote(byte note, byte velocity, byte channel, int detune);
void playNoteB(byte note, byte velocity, byte channel, int detune);
void stopNote();
void stopNoteB();

//Port settings
const int ad0 = 8;
const int ad1 = 9;
const int ad2 = 2;
const int ad3 = 3;
const int ad4 = 4;
const int ad5 = 5;
const int ad6 = 6;
const int ad7 = 7;
const int pinBC1 = 10;   
const int pinBDIR = 11;
//BC2 to +5V
const int pinYMReset = 12;

// Buttons on Analogue Pin A1
#define buttonPin A1       // analog input pin to use as a digital input

//banks
bool setBankB;
  
//voicing
byte noteA = 0;
byte noteB = 0;
byte noteC = 0;
int periodA = 0;
int periodB = 0;
int periodC = 0;

//MIDI MUTES
int mm0=0;
int mm1=0;
int mm2=0;
int mm3=0;
int mm4=0;
int mm5=0;
int mm6=0;
int mm7=0;

//envelope
byte AmaxVolume = 0;
byte BmaxVolume = 0;
byte CmaxVolume = 0;

//detune
int detuneValue = 1;
int detuneActiveA = 0;
int detuneActiveB = 0;
int detuneActiveC = 0;

//arpeggio settings
byte pattern1[] = {0, 7, 12};          // Up
byte pattern2[] = {12, 7, 0};          // Down
byte pattern3[] = {0, 12, 7, 0};       // Up and down
byte pattern4[] = {0, 4, 7, 12, 7};    // Custom pattern
byte pattern5[] = {0, 4, 7, 12};       // Up with a pause on 4th
byte pattern6[] = {12, 4, 7, 0};       // Down with a pause on 4th
byte pattern7[] = {0, 7, 4, 12, 7};    // Up with a twist on 4th and 7th
byte pattern8[] = {0, 12, 4, 7, 12};   // Up and down with a full octave spread
byte pattern9[] = {0, 3, 7, 10};       // Minor 7th chord: Root, minor third, fifth, minor seventh
byte pattern10[] = {0, 3, 7, 10, 14};   // Minor 9th chord: Root, minor third, fifth, minor seventh, minor ninth
byte pattern11[] = {0, 3, 7, 9};       // Minor with flat sixth: Root, minor third, fifth, flat sixth
byte pattern12[] = {0, 5, 7, 10};      // Dominant 7th: Root, major third, fifth, minor seventh (Foxtrot)
byte pattern13[] = {0, 7, 12};         // Root, fifth, octave - Power chord (Root-Fifth-Octave)
byte pattern14[] = {0, 3, 7, 10};      // Root, minor third, fifth, minor seventh - Minor 7th chord
byte pattern15[] = {0, 4, 7, 12};      // Root, major third, fifth, octave - Classic Rock
byte pattern16[] = {0, 5, 7, 10};      // Root, fifth, minor seventh, dominant seventh - Blues progression


byte* currentPattern = pattern1; // Pointer to the currently active pattern
byte arpeggioLength = sizeof(pattern1); // Length of the active pattern
byte arpeggioCounter = 0;
boolean arpeggioFlipMe = false;
int currentArpNote;
int arpMod = 0;
int octaveOffset = 0;

byte defaultLevel = 10;

//pitch bend
int pitchBendValue = 0;
float pitchBendRange = 16384.0; // multiple of 8192.0, the smaller the more the bend range.

//volume
byte volume;

//velocity
byte velo;
int velocityValue = 127;
int velocityStatus = 0;

//envelop
byte envelopeShape = 0;
const byte envelopeShapes[] = {
};

//short notes
int noteLength = 100;
int noteLengthDelay = 0;

//vibrato
int vibratoRate = 0;
int vibratoDepth = 0; 
int vibratoCounter = 0;
boolean vibratoOn = false;

//note activity
int noteActiveA = 0;
int noteActiveB = 0;
int noteActiveC = 0;

//cc Controls
int controlValue1;
int controlValue2;
int controlValue3;
int controlValue4;
int controlValue5;
int controlValue6;
int controlValue7;
int controlValue8;
int controlValue9;
int controlValue10;

//Fast pin switching macros
//#define CLR(x,y) (x&=(~(1<<y)))
//#define SET(x,y) (x|=(1<<y))
//#define SET(PORT, PIN) ((PORT) |= (1 << (PIN)))
//#define CLR(PORT, PIN) ((PORT) &= ~(1 << (PIN)))

void setPinHigh(volatile uint8_t &port, uint8_t pin) {
    asm volatile(
        "sbi %[port], %[pin]"
        : // No output
        : [port] "I" (_SFR_IO_ADDR(port)), [pin] "I" (pin)
    );
}

void setPinLow(volatile uint8_t &port, uint8_t pin) {
    asm volatile(
        "cbi %[port], %[pin]"
        : // No output
        : [port] "I" (_SFR_IO_ADDR(port)), [pin] "I" (pin)
    );
}

#define __BCPORT__ PORTB
#define __BC1__ 2
#define __BDIR__ 3

#define __LEDPORT__ PORTB
#define __LED__ 5

#define CLEAR(port, pin) (port &= ~(1 << pin))

const int ledPin = 13;

const int tp[] = {0, 0, 0, 0, 0, 0, 0, 0, 0, 0, 0, 4050,
                   3822, 3608, 3405, 3214, 3034, 2863, 2703, 2551, 2408, 2273, 2145, 4050, 3822,
                   3608, 3405, 3214, 3034, 2863, 2703, 2551, 2408, 2273, 2145, 2025, 1911, 1804, 1703,
                   1607, 1517, 1432, 1351, 1276, 1204, 1136, 1073, 1012, 956, 902, 851, 804, 758,
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                   12, 11, 11, 10 };

// Samples C3-E3                   
                   
const int envTp[] = {3822, 3608, 3405, 3214, 3034, 2863, 2703, 2551, 2408, 2273, 2145, 2025, 1911,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 3, 2};

PROGMEM const char s0[] = {13, 14, 14, 13, 14, 15, 12, 14, 10, 14, 12, 14, 14,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 11, 10};
const int s0Length = 931;
PROGMEM const char s1[] = {13, 14, 14, 14, 14, 14, 14, 13, 14, 14, 14, 13, 14,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 14, 13};
const int s1Length = 1780;
PROGMEM const char s2[] = {15, 13, 12, 13, 13, 14, 13, 15, 14, 13, 14, 13, 13,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 13, 13};
const int s2Length = 463;
PROGMEM const char s3[] = {7, 6, 7, 7, 8, 8, 8, 8, 9, 9, 9, 10, 10,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 8, 8};
const int s3Length = 2982;
PROGMEM const char s4[] = {0, 0, 0, 0, 0, 0, 0, 15, 15, 15, 15, 15, 15,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 0, 0};
const int s4Length = 741;
//const char* samplePointers[] = {s0, s1, s2, s3, s4};
//int sampleLength[] = {931,1780,463,8011,2869};
 
//Timer
const char* sampleOffset;
int sampleCounter = 0;
int sampleLength = 0;
int timerTicks = 0;

ISR(TIMER1_COMPA_vect)
{
  timerTicks++;
  if (sampleCounter < sampleLength) //send current sample
  {
    send_data(0x0A, pgm_read_byte_near(sampleOffset + sampleCounter++));
  }
 if (controlValue2 == 0) {
    // Force vibrato to stop by resetting the vibrato offset and counter
    vibratoCounter = 0;      // Reset vibrato counter immediately
    vibratoDepth = 0;        // Set vibrato depth to 0 to stop the effect
    vibratoRate = 0;         // Optionally, you can set vibrato rate to 0
}
 int modulatedPeriodA;
 int modulatedPeriodB;
 int modulatedPeriodC;
 if (noteActiveA == 1 && controlValue2 >= 1) {
        // Calculate vibrato effect
        setPinHigh(__LEDPORT__, __LED__);
        int vibratoOffset = vibratoDepth * sin(vibratoCounter * vibratoRate);
        if (controlValue5 == 0) { 
        modulatedPeriodA = (tp[noteA]  + detuneValue) + vibratoOffset; } else { 
        modulatedPeriodA = (tp[currentArpNote] + detuneValue) + vibratoOffset;  
        }

        // Send modulated period to YM2149 channel
        send_data(0x00, modulatedPeriodA & 0xFF); // LSB
        send_data(0x01, (modulatedPeriodA >> 8) & 0x0F); // MSB

        // Update vibrato counter for oscillation
vibratoCounter += vibratoRate;
if (vibratoCounter >= 360) vibratoCounter -= 360;  // Reset to prevent overflow
    }

     else if (noteActiveB == 1 && controlValue2 >= 1) {
        // Calculate vibrato effect
        setPinHigh(__LEDPORT__, __LED__);
        int vibratoOffset = vibratoDepth * sin(vibratoCounter * vibratoRate);
        if (controlValue5 == 0) { 
        modulatedPeriodB = (tp[noteB] + detuneValue) + vibratoOffset; } else { 
        modulatedPeriodB = (tp[currentArpNote] + detuneValue) + vibratoOffset;  
        }

        // Send modulated period to YM2149 channel
        send_data(0x02, modulatedPeriodB & 0xFF); // LSB
        send_data(0x03, (modulatedPeriodB >> 8) & 0x0F); // MSB

        // Update vibrato counter for oscillation
vibratoCounter += vibratoRate;
if (vibratoCounter >= 360) vibratoCounter -= 360;  // Reset to prevent overflow
    }

         else if (noteActiveC == 1 && controlValue2 >= 1) {
        // Calculate vibrato effect
        setPinHigh(__LEDPORT__, __LED__);
        int vibratoOffset = vibratoDepth * sin(vibratoCounter * vibratoRate);
        if (controlValue5 == 0) { 
        modulatedPeriodC = (tp[noteC]  + detuneValue) + vibratoOffset; } else { 
        modulatedPeriodC = (tp[currentArpNote]  + detuneValue) + vibratoOffset;  
        }

        // Send modulated period to YM2149 channel
        send_data(0x04, modulatedPeriodC & 0xFF); // LSB
        send_data(0x05, (modulatedPeriodC >> 8) & 0x0F); // MSB

        // Update vibrato counter for oscillation
vibratoCounter += vibratoRate;
if (vibratoCounter >= 360) vibratoCounter -= 360;  // Reset to prevent overflow
    }

  int arpeggioSpeed = map(controlValue5, 0, 127, 50, 1);

    if (timerTicks >= arpeggioSpeed && noteActiveA == 1 && controlValue5 >= 1)
  {
        timerTicks = 0;
        setPinHigh(__LEDPORT__, __LED__);
        if (controlValue7 <= 64) {arpMod = 1;} else {arpMod = 0;}
        periodA = tp[(noteA + octaveOffset) + currentPattern[arpeggioCounter]];
        currentArpNote = (noteA + octaveOffset) + currentPattern[arpeggioCounter] ;
        byte LSB = (periodA & 0x00FF); // Get the LSB of the period
        byte MSB = ((periodA & 0x0F00) >> 8); // Get the MSB of the period
        send_data(0x00, LSB); // Send LSB to register 0x00
        send_data(0x01, MSB); // Send MSB to register 0x01
        if (arpMod == 1){} else {
        send_data(0x08, volume);} // Send volume based on velocity
        arpeggioCounter++;
        if (arpeggioCounter == arpeggioLength) arpeggioCounter = 0;
  }
  else if (timerTicks >= arpeggioSpeed && noteActiveB == 1 && controlValue5 >= 1)
  {
        timerTicks = 0;
        setPinHigh(__LEDPORT__, __LED__);
        if (controlValue7 <= 64) {arpMod = 1;} else {arpMod = 0;}
        periodB = tp[(noteB + octaveOffset) + currentPattern[arpeggioCounter]];
        currentArpNote = (noteB + octaveOffset) + currentPattern[arpeggioCounter] ;
        byte LSB = ( periodB & 0x00FF);
        byte MSB = ((periodB >> 8) & 0x000F);
        send_data(0x02, LSB);
        send_data(0x03, MSB);
        if (arpMod == 1){} else {
        send_data(0x09, volume);} // Send volume based on velocity
        arpeggioCounter++;
        if (arpeggioCounter == arpeggioLength) arpeggioCounter = 0;
  }
   else  if (timerTicks >= arpeggioSpeed && noteActiveC == 1 && controlValue5 >= 1)
  {
        timerTicks = 0;
        setPinHigh(__LEDPORT__, __LED__);
        if (controlValue7 <= 64) {arpMod = 1;} else {arpMod = 0;}
        periodC = tp[(noteC + octaveOffset) + currentPattern[arpeggioCounter]];
        currentArpNote = (noteC + octaveOffset) + currentPattern[arpeggioCounter] ;
        byte LSB = ( periodC & 0x00FF);
        byte MSB = ((periodC >> 8) & 0x000F);
        send_data(0x04, LSB);
        send_data(0x05, MSB);
        if (arpMod == 1){} else {
        send_data(0x0A, volume);} // Send volume based on velocity
        arpeggioCounter++;
        if (arpeggioCounter == arpeggioLength) arpeggioCounter = 0;
  }
    if (timerTicks > 255) {  // Prevent overflow, assuming an 8-bit limit
        timerTicks = 0;
    }
}

void setup(){
  //init pins
  pinMode(ad0, OUTPUT);
  pinMode(ad1, OUTPUT);
  pinMode(ad2, OUTPUT);
  pinMode(ad3, OUTPUT);
  pinMode(ad4, OUTPUT);
  pinMode(ad5, OUTPUT);
  pinMode(ad6, OUTPUT);
  pinMode(ad7, OUTPUT);
  pinMode(pinBC1, OUTPUT);
  pinMode(pinBDIR, OUTPUT);
  pinMode(pinYMReset, OUTPUT);
  pinMode(ledPin, OUTPUT);
  pinMode(buttonPin, INPUT);
  
  resetYM();
  
  AmaxVolume = defaultLevel;
  BmaxVolume = defaultLevel;
  CmaxVolume = defaultLevel;
  
  //serial init
  Serial.begin(31250);
    // Start the MIDI output serial port
  
  //timer1 : sample player
  cli();
  TCCR1A = 0;           // Reset Timer1 Control Register A
  TCCR1B = 0;           // Reset Timer1 Control Register B
  OCR1A = 250;        // Set compare value for a ~1 Hz frequency with 256 prescaler (adjust as needed)
  TCCR1B |= (1 << WGM12); // Enable CTC mode
  TCCR1B |= (1 << CS12);  // Set prescaler to 256
  TCCR1B |= (1 << CS10);  // Set prescaler to 256
  TIMSK1 |= (1 << OCIE1A); // Enable Timer1 compare interrupt
  sei();
  
  //say hello
  //This is the bleep played on power on.
      ////note/velo/channel
playNote(78, 127, 1, 0);  // F#5
delay(30);             // Shorter delay for chiptune feel
playNote(76, 127, 1, 0);  // E5
delay(30);
playNote(74, 127, 1, 0);  // D5
delay(30);
playNote(72, 127, 1, 0);  // C5
delay(30);
playNote(70, 127, 1, 0);  // B4
delay(30);
playNote(69, 127, 1, 0);  // A4
delay(30);
playNote(67, 127, 1, 0);  // G4
delay(30);
playNote(65, 127, 1, 0);  // F4
delay(30);
playNote(64, 127, 1, 0);  // E4
delay(30);
playNote(62, 127, 1, 0);  // D4
delay(30);
stopNote(62, 1);       // Stop D4       // Stop D4
}//END OF SETUP

// Main Loop
void loop() {
  byte command = getSerialByte();
  byte commandMSB  = command & 0xF0;
  byte midiChannel = command & 0x0F;
  
  if (commandMSB == 0x80) //Note off
  {
    byte note = getSerialByte();
    if (setBankB == false) {
      stopNote(note, midiChannel);
    } else if (setBankB == true) {
      stopNoteB(note, midiChannel);
    }
  }

  else if (commandMSB == 0x90) //Note on
  {
byte note = getSerialByte();
velo = getSerialByte();

// Ensure velocity is within the valid range (0-127)
if (velo < 0) {
    velo = 0; // Ensure velocity does not go below 0
} else if (velo > 127) {
    velo = 127; // Ensure velocity does not exceed 127
}

// Apply controlValue4 adjustment (1 = most sensitive, 127 = least sensitive)
if (controlValue4 == 0) {
noteLengthDelay = map(controlValue10, 0, 127, 20, 80); // Adjust delay range to suit your needs
    velo = 127; // Full velocity if CC4 is 0
} else {
    velo = map(velo, 0, 127, map(controlValue4, 127, 1, 64, 127), 127);
}

velocityValue = velo;  // Store the final velocity value
    // Ifi ts Midi channel 10 we trigger samples using the playDigidrum(); function. 
if (velo != 0 && midiChannel == 0x09) {
    playDigidrum(note, velo);
}
else if (velo != 64 && setBankB == false) {
    playNote(note, velo, midiChannel, (pitchBendValue));
    if (controlValue10 > 0) {
        delay(noteLengthDelay); // Apply delay for note length adjustment
        stopNote(note, midiChannel); // Stop the note after delay
    }
}
else if (velo != 64 && setBankB == true) {
    playNoteB(note, velo, midiChannel, (pitchBendValue));
    if (controlValue10 > 0) {
        delay(noteLengthDelay); // Apply delay for note length adjustment
        stopNoteB(note, midiChannel); // Stop the note after delay
    }
}
else if (velo == 64 && setBankB == false) {
    stopNote(note, midiChannel);
}
else if (velo == 64 && setBankB == true) {
    stopNoteB(note, midiChannel);
}
  }
  else if (commandMSB == 0xA0) // Key pressure
  {
    getSerialByte();
    getSerialByte();
  }
 else if (command >= 0xB0 && command <= 0xBF) // Control WIP
  {   
    byte controlNumber = getSerialByte(); // Read the second byte (control number)
    byte controlValue = getSerialByte();  // Read the third byte (value)
if (controlNumber == 1) {
    controlValue1 = controlValue;
    detuneValue = map(controlValue1, 0, 127, -64, 63);

    // Define arrays for each note and active flags to iterate over
    byte notes[] = {noteA, noteB, noteC};
    bool noteActives[] = {noteActiveA, noteActiveB, noteActiveC};
    bool detuneActives[] = {detuneActiveA, detuneActiveB, detuneActiveC};

    for (int i = 0; i < 3; i++) {
        if (noteActives[i] && detuneActives[i]) {
            if (setBankB == false) {
                playNote(notes[i], velocityValue, midiChannel, pitchBendValue);
            } else {
                playNoteB(notes[i], velocityValue, midiChannel, pitchBendValue);
            }
        }
    }
} 
if (controlNumber == 2) { 
    controlValue2 = controlValue;
vibratoRate = map(controlValue2, 1, 127, 1, 10); 
}

if (controlNumber == 3) { 
    controlValue3 = controlValue;
    vibratoDepth = map(controlValue3, 1, 127, 0, 12); // Adjust depth; higher values = stronger effect
}
  if (controlNumber == 4) {
    controlValue4 = controlValue; }
  if (controlNumber == 5) {
    controlValue5 = controlValue; }
if (controlNumber == 6) { 
    switch (controlValue) {
      timerTicks = 0;
        delay(15);
        case 0 ... 7:
            currentPattern = pattern1; // Pattern 1
            arpeggioLength = sizeof(pattern1);
            break;
        case 8 ... 15:
            currentPattern = pattern2; // Pattern 2
            arpeggioLength = sizeof(pattern2);
            break;
        case 16 ... 23:
            currentPattern = pattern3; // Pattern 3
            arpeggioLength = sizeof(pattern3);
            break;
        case 24 ... 31:
            currentPattern = pattern4; // Pattern 4
            arpeggioLength = sizeof(pattern4);
            break;
        case 32 ... 39:
            currentPattern = pattern5; // Pattern 5
            arpeggioLength = sizeof(pattern5);
            break;
        case 40 ... 47:
            currentPattern = pattern6; // Pattern 6
            arpeggioLength = sizeof(pattern6);
            break;
        case 48 ... 55:
            currentPattern = pattern7; // Pattern 7
            arpeggioLength = sizeof(pattern7);
            break;
        case 56 ... 63:
            currentPattern = pattern8; // Pattern 8
            arpeggioLength = sizeof(pattern8);
            break;
        case 64 ... 71:
            currentPattern = pattern9; // Pattern 9
            arpeggioLength = sizeof(pattern9);
            break;
        case 72 ... 79:
            currentPattern = pattern10; // Pattern 10
            arpeggioLength = sizeof(pattern10);
            break;
        case 80 ... 87:
            currentPattern = pattern11; // Pattern 11
            arpeggioLength = sizeof(pattern11);
            break;
        case 88 ... 95:
            currentPattern = pattern12; // Pattern 12
            arpeggioLength = sizeof(pattern12);
            break;
        case 96 ... 103:
            currentPattern = pattern13; // Pattern 13
            arpeggioLength = sizeof(pattern13);
            break;
        case 104 ... 111:
            currentPattern = pattern14; // Pattern 14
            arpeggioLength = sizeof(pattern14);
            break;
        case 112 ... 119:
            currentPattern = pattern15; // Pattern 15
            arpeggioLength = sizeof(pattern15);
            break;
        case 120 ... 127:
            currentPattern = pattern16; // Pattern 16
            arpeggioLength = sizeof(pattern16);
            break;
    }
}
if (controlNumber == 7) {
controlValue7 = controlValue;
}if (controlNumber == 8) {
    switch (controlValue) {
        case 0:
           octaveOffset = 0;
            break;
        case 1 ... 21:
            octaveOffset = -36;
            break;
        case 22 ... 43:
            octaveOffset = -24;
            break;
        case 44 ... 63:
            octaveOffset = -12;
            break;
        case 64 ... 84:
            octaveOffset = 0;
            break;
        case 85 ... 105:
            octaveOffset = 12;
            break;
        case 106 ... 126:
            octaveOffset = 24;
            break;
        case 127:
            octaveOffset = 36;
            break;
    }
}
  if (controlNumber == 9) {
  if (controlValue > 64){setBankB = true;} else {setBankB = false;}
  }
  if (controlNumber == 10) {
    controlValue10 = controlValue;
    noteLength = map(controlValue, 0, 127, 300, 2000); // 10 ms for very short, up to 200 ms
  }
  }
  else if (commandMSB == 0xC0) // Program change
  {
    byte program = getSerialByte();
  }
  else if (commandMSB == 0xD0) // Channel pressure
  {
    byte pressure = getSerialByte();
  }
  else if (commandMSB == 0xE0) // Pitch bend
  { 
    setPinHigh(__LEDPORT__, __LED__);
    byte pitchBendLSB = getSerialByte();
    byte pitchBendMSB = getSerialByte();
    pitchBendValue = ((pitchBendMSB << 7) | pitchBendLSB) - 8192; // Adjust to -8192 to +8191 range
    pitchBendValue = -pitchBendValue; // Invert to correct direction
        // Now you can use pitchBendValue as needed
        // For example, you might want to replay the note with the new pitch bend value
        if (noteActiveA == 1 && setBankB == false) {
        playNote(noteA, velocityValue, midiChannel, pitchBendValue); }
        if (noteActiveB == 1 && setBankB == false) {
        playNote(noteB, velocityValue, midiChannel, pitchBendValue); }
        if (noteActiveC == 1 && setBankB == false) {
        playNote(noteC, velocityValue, midiChannel, pitchBendValue); }
        if (noteActiveA == 1 && setBankB == true) {
        playNoteB(noteA, velocityValue, midiChannel, pitchBendValue); }
        if (noteActiveB == 1 && setBankB == true) {
        playNoteB(noteB, velocityValue, midiChannel, pitchBendValue); }
        if (noteActiveC == 1 && setBankB == true) {
        playNoteB(noteC, velocityValue, midiChannel, pitchBendValue); }
   CLEAR(__LEDPORT__, __LED__); 
  }
}

void setChannelVolume(byte value, byte chan)
{
  value = (value >> 3) & 0x0F; //downscaling to 4 bits
  
  if (chan == 0)
  {
    AmaxVolume = value;
    send_data(0x08, value);
  }  
  else if (chan == 1)
  {
    BmaxVolume = value;
    send_data(0x09, value);
  }
  else if (chan == 2)
  {
    CmaxVolume = value;
    send_data(0x0A, value);
  } 
}

// Drums
void playDigidrum(byte index, byte velo)
{
  if (index == 64)
  {
    cli();
    
    sampleOffset = s0;
    sampleLength = s0Length;
    sampleCounter = 0;
    sei();
  }
  else if (index == 63)
  {
    cli();
 
    sampleOffset = s1;
    sampleLength = s1Length;
    sampleCounter = 0;
    sei();
  }
  else if (index == 62)
  {
    cli();

    sampleOffset = s2;
    sampleLength = s2Length;
    sampleCounter = 0;
    sei();
  }
  else if (index == 61)
  {
    cli();
 
    sampleOffset = s3;
    sampleLength = s3Length;
    sampleCounter = 0;
    sei();
  }
  else if (index == 60)
  {
    cli();
  
    sampleOffset = s4;
    sampleLength = s4Length;
    sampleCounter = 0;
    sei();
  }
}

void resetYM()
{
    digitalWrite(pinYMReset, LOW);
    digitalWrite(pinYMReset, HIGH);
    delay(1);
    send_data(0x07, 0b00111000);
    for (byte i=0; i <= defaultLevel; i++)
    {
      send_data(0x08, i);
      send_data(0x09, i);
      send_data(0x0A, i);
      delay(1);
    }
}

void send_data(unsigned char address, unsigned char data)
{
  boolean value[8];
  
  //put address in a 8-bit array
  for (int i; i < 8; i++)
  {
    value[i] = ((0x01 & address) == 1);
    address = address >> 1;
  }
  //write address to pins
  outputToYM(value);
  //validate addess
  __BCPORT__ |=   (1 << __BDIR__) | (1 << __BC1__);
  delayMicroseconds(1);
  __BCPORT__ &= ~((1 << __BDIR__) | (1 << __BC1__));

  //put data in a 8-bit array
  for (int i; i < 8; i++)
  {
    value[i] = ((0x01 & data) == 1);
    data = data >> 1;
  }
  //write data to pins
  outputToYM(value);
  //validate data
  setPinHigh(__BCPORT__,__BDIR__);
  delayMicroseconds(1);
 setPinLow(__BCPORT__,__BDIR__);
 setPinLow(__LEDPORT__,__LED__);
}

void outputToYM(boolean value[])
{
  value[0] ? setPinHigh(PORTB, 0) : setPinLow(PORTB, 0);
  value[1] ? setPinHigh(PORTB, 1) : setPinLow(PORTB, 1);
  value[2] ? setPinHigh(PORTD, 2) : setPinLow(PORTD, 2);
  value[3] ? setPinHigh(PORTD, 3) : setPinLow(PORTD, 3);
  value[4] ? setPinHigh(PORTD, 4) : setPinLow(PORTD, 4);
  value[5] ? setPinHigh(PORTD, 5) : setPinLow(PORTD, 5);
  value[6] ? setPinHigh(PORTD, 6) : setPinLow(PORTD, 6);
  value[7] ? setPinHigh(PORTD, 7) : setPinLow(PORTD, 7);
}

byte getSerialByte()
{
  while(Serial.available() < 1) __asm__("nop\n\t");
  return Serial.read();
}
